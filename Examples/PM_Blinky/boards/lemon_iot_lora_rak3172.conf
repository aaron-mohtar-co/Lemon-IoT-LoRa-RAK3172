## Zephyr board files/arm/lemon_iot_lora_rak3172/Kconfig.board
```kconfig
# RAK3172 Lemon IoT LoRa board configuration

# Copyright (c) 2023 Aaron Mohtar & Co Pty Ltd
# SPDX-License-Identifier: Apache-2.0

config BOARD_LEMON_IOT_LORA_RAK3172
	bool "Lemon IoT LoRa RAK3172"
	depends on SOC_STM32WLE5XX
```

## Zephyr board files/arm/lemon_iot_lora_rak3172/Kconfig.defconfig
```kconfig
# RAK3172 Lemon IoT LoRa board configuration

# Copyright (c) 2023 Aaron Mohtar & Co Pty Ltd
# SPDX-License-Identifier: Apache-2.0

if BOARD_LEMON_IOT_LORA_RAK3172

config BOARD
	default "lemon_iot_lora_rak3172"

endif # BOARD_LEMON_IOT_LORA_RAK3172
```
