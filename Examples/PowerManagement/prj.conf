## CMakeLists.txt
```
# SPDX-License-Identifier: Apache-2.0

cmake_minimum_required(VERSION 3.20.0)

find_package(Zephyr REQUIRED HINTS $ENV{ZEPHYR_BASE})
project(Power_Management)

FILE(GLOB app_sources src/*.c)
target_sources(app PRIVATE ${app_sources})
```

## prj.conf
```kconfig
CONFIG_SERIAL=y
CONFIG_CONSOLE=y
CONFIG_PM=y
CONFIG_STM32_LPTIM_CLOCK_LSE=y
CONFIG_PM_DEVICE=y
CONFIG_PM_DEVICE_RUNTIME=y
CONFIG_DEBUG=n
CONFIG_LOG=y

CONFIG_POWEROFF=y
```

## boards/lemon_iot_lora_rak3172.overlay
```dts
/*
 * Lemon IoT LoRa RAK3172 overlay
 * Copyright (c) 2023 Aaron Mohtar & Co Pty Ltd
 *
 * SPDX-License-Identifier: Apache-2.0
 */

/ {
	chosen {
		zephyr,console = &lpuart1;
		zephyr,shell-uart = &lpuart1;
	};
};

&lpuart1 {
	pinctrl-0 = <&lpuart1_tx_pa2 &lpuart1_rx_pa3>;
	pinctrl-names = "default";
	current-speed = <115200>;
	status = "okay";
};
```

## src/main.c
```c
/*
 * RAK3172 Power Management example
 *
 */

#include <stdio.h>
#include <string.h>
#include <zephyr/device.h>
#include <zephyr/kernel.h>
#include <zephyr/drivers/uart.h>
#include <zephyr/pm/pm.h>
#include <zephyr/pm/policy.h>
#include <zephyr/logging/log.h>
#include <zephyr/sys/poweroff.h>

LOG_MODULE_REGISTER(main);

const char *pm_state_names[] = {"Active", "Runtime Idle", "Suspend to Idle", "Standby", "Suspend to RAM", "Suspend to Disk", "Soft-off", "Count" };

int main(void)
{
	uint8_t num_cpu_states;
	const struct pm_state_info *cpu_states;

	LOG_INF("Power Management Example");
	LOG_INF("Board: %s", CONFIG_BOARD);

	num_cpu_states = pm_state_cpu_get_all(0u, &cpu_states);
	LOG_INF("Number of Power Management States: %d", num_cpu_states);

	for (uint8_t i = 0U; i < num_cpu_states; i++) {
		LOG_INF("State %d: %s, substrate-id: %d", i, pm_state_names[cpu_states[i].state], cpu_states[i].substate_id);
		LOG_INF("          min-residency: %dus, exit-latency: %dus", cpu_states[i].min_residency_us, cpu_states[i].exit_latency_us);
	}

	while (1) {

		LOG_INF("Wakeup");
		k_sleep(K_SECONDS(10));

		//pm_state_force(0u, &(struct pm_state_info) {PM_STATE_RUNTIME_IDLE, 0, 0, 0});
		//pm_state_force(0u, &(struct pm_state_info) {PM_STATE_SUSPEND_TO_IDLE, 2, 0, 0});
		//pm_state_force(0u, &(struct pm_state_info) {PM_STATE_SUSPEND_TO_IDLE, 3, 0, 0});
		//pm_state_force(0u, &(struct pm_state_info) {PM_STATE_SOFT_OFF, 0, 0, 0});
		//pm_state_force(0u, &(struct pm_state_info) {PM_STATE_STANDBY, 0, 0, 0});
		//sys_poweroff();
	}
}
```
