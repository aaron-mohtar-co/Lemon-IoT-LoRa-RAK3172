## prj.conf
```kconfig
CONFIG_SERIAL=y
CONFIG_CONSOLE=y
CONFIG_UART_CONSOLE=y

CONFIG_ENTROPY_GENERATOR=y
CONFIG_ENTROPY_STM32_RNG=y
CONFIG_ENTROPY_STM32_CLK_CHECK=y
```

## boards/lemon_iot_lora_rak3172.overlay
```dts
/*
 * Copyright (c) 2023 Aaron Mohtar & Co Pty Ltd
 *
 * Random Number Generator (RNG) must be clocked from 48MHz. We enable PLL to
 * generate this. If the clock speed is wrong, the device may not boot.
 *
 * SPDX-License-Identifier: Apache-2.0
 */

&clk_hse {
	status = "okay";
	clock-frequency = <DT_FREQ_M(32)>;
};

&pll {
	status = "okay";
	div-m = <1>;
	mul-n = <3>;
	div-r = <2>;
	div-q = <2>;
	clocks = <&clk_hse>;
};

&rcc {
	clocks = <&pll>;
	clock-frequency = <DT_FREQ_M(48)>;
	cpu1-prescaler = <1>;
	ahb3-prescaler = <1>;
	apb1-prescaler = <1>;
	apb2-prescaler = <1>;
};

&rng {
	status = "okay";
};
```

## src/main.c
```c
#include <stdio.h>
#include <string.h>
#include <zephyr/device.h>
#include <zephyr/kernel.h>
#include <zephyr/random/random.h>

int main(void)
{
	uint8_t app_key[16];

	printk("Zephyr Random Number Generator Example \nBoard: %s\n", CONFIG_BOARD);

	while(1) {
		
		// Return a 32-bit random value that should pass general randomness tests: 
		//uint32_t random = sys_rand32_get();
		//printk("%d\n",random);
		
		// Fill the destination buffer with random data values that should pass general randomness tests:
		//sys_rand_get(app_key, 16);

		// Fill the destination buffer with cryptographically secure random data values:
		sys_csrand_get(app_key, 16);

		for (int i = 0; i < 16; i++)
			printk("%02X ",app_key[i]);
		printk("\n");

		k_sleep(K_MSEC(500));
	}
}
```
